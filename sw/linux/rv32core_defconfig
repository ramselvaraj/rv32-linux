## sw/linux/rv32core_defconfig
```kconfig
BR2_riscv=y
BR2_RISCV_32=y
BR2_RISCV_ISA_CUSTOM_RVM=y
BR2_RISCV_ISA_CUSTOM_RVA=y
BR2_RISCV_ABI_ILP32=y
BR2_PACKAGE_HOST_LINUX_HEADERS_CUSTOM_6_18=y
BR2_TOOLCHAIN_BUILDROOT_MUSL=y
BR2_TARGET_GENERIC_HOSTNAME="rv32"
BR2_TARGET_GENERIC_ISSUE="Welcome to rv32-linux"
BR2_SYSTEM_DHCP=""
BR2_TARGET_GENERIC_GETTY_PORT="ttyS0"
BR2_TARGET_GENERIC_GETTY_BAUDRATE_115200=y
BR2_ROOTFS_OVERLAY=""
BR2_LINUX_KERNEL=y
BR2_LINUX_KERNEL_CUSTOM_VERSION=y
BR2_LINUX_KERNEL_CUSTOM_VERSION_VALUE="6.18.7"
BR2_LINUX_KERNEL_DEFCONFIG="rv32"
BR2_LINUX_KERNEL_CONFIG_FRAGMENT_FILES="/mnt/windows/Users/ramse/linux_projects/rv32-linux/sw/linux/rv32core.fragment"
BR2_LINUX_KERNEL_IMAGE=y
BR2_TARGET_ROOTFS_CPIO=y
BR2_TARGET_ROOTFS_INITRAMFS=y
```
